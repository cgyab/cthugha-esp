## main/Kconfig.projbuild
```kconfig
menu "Cthugha Configuration"

    menu "LCD Display"
        config CTHUGHA_LCD_BL_GPIO
            int "Backlight GPIO number"
            default 26

        config CTHUGHA_LCD_RST_GPIO
            int "LCD reset GPIO number"
            default 27
    endmenu

    menu "I2S Microphone"
        config CTHUGHA_I2S_NUM
            int "I2S peripheral number"
            default 0

        config CTHUGHA_I2S_MCLK_GPIO
            int "I2S master clock GPIO"
            default 13

        config CTHUGHA_I2S_BCK_GPIO
            int "I2S bit clock GPIO"
            default 12

        config CTHUGHA_I2S_WS_GPIO
            int "I2S word select GPIO"
            default 10

        config CTHUGHA_I2S_DIN_GPIO
            int "I2S data in GPIO"
            default 11

        config CTHUGHA_I2S_DOUT_GPIO
            int "I2S data out GPIO (codec DAC)"
            default 9

        config CTHUGHA_I2S_SAMPLE_RATE
            int "Sample rate (Hz)"
            default 16000
    endmenu

    menu "I2C Touch"
        config CTHUGHA_TOUCH_I2C_NUM
            int "I2C peripheral number"
            default 0

        config CTHUGHA_TOUCH_I2C_SDA_GPIO
            int "I2C SDA GPIO"
            default 7

        config CTHUGHA_TOUCH_I2C_SCL_GPIO
            int "I2C SCL GPIO"
            default 8

        config CTHUGHA_TOUCH_RST_GPIO
            int "Touch reset GPIO"
            default 5

        config CTHUGHA_TOUCH_INT_GPIO
            int "Touch interrupt GPIO"
            default 6
    endmenu

    menu "SD Card Recording"
        config CTHUGHA_SDCARD_ENABLED
            bool "Enable SD card AVI recording"
            default n
            help
                When enabled, the visualization can be recorded to an SD card as
                an uncompressed AVI file.  Toggle recording with a four-finger tap
                while in locked mode.  Convert for YouTube with:
                  ffmpeg -i cth0001.avi -vf scale=720:720 out.mp4

        config CTHUGHA_SDCARD_LDO_CHAN
            int "Internal LDO channel powering the SD card slot"
            default 4
            depends on CTHUGHA_SDCARD_ENABLED
            help
                On the Waveshare ESP32-P4-WIFI6-Touch-LCD-4B, LDO 4 provides
                3.3V to the SD card slot.  Must be configured via sd_pwr_ctrl
                and attached to the SDMMC host before mounting.

        config CTHUGHA_SDCARD_MAX_RECORDINGS
            int "Maximum number of recordings to keep"
            default 10
            range 1 9999
            depends on CTHUGHA_SDCARD_ENABLED
            help
                When this limit is reached, numbering wraps back to 0001 and
                old files are overwritten.

        config CTHUGHA_SDCARD_MAX_FRAMES
            int "Maximum frames per recording"
            default 2700
            range 60 216000
            depends on CTHUGHA_SDCARD_ENABLED
            help
                Recording stops automatically after this many frames.
                At 15 fps: 2700 = 180 s (3 min), 1800 = 120 s.

        config CTHUGHA_SDCARD_FPS
            int "Recording frame rate"
            default 15
            range 1 60
            depends on CTHUGHA_SDCARD_ENABLED
            help
                Frames per second in the output AVI.  Every (60/FPS) render
                frames are sampled, so the render loop is not slowed.
                Consumer A2 cards sustain ~1 MB/s writes; 15 fps × 57 KB =
                ~855 KB/s fits within that ceiling.  Higher rates will drop
                frames on typical cards.

        config CTHUGHA_SDCARD_NUM_BUFS
            int "Number of PSRAM frame buffers"
            default 3
            range 2 16
            depends on CTHUGHA_SDCARD_ENABLED
            help
                Ring buffer depth for the SD writer.  Each buffer is 58 KB
                in PSRAM (57,600 bytes indexed + 8-byte chunk header).
                8 buffers absorb a full 250 ms SD slow-flush window at 15 fps
                without dropping frames.
    endmenu

endmenu
```
